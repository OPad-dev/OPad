## firmware/main/Kconfig.projbuild
```kconfig
menu "OPad Testing and Benchmark"

    config OPAD_TEST_FAIL_LCD
        bool "Force display initialization to fail (P0-1 test)"
        default n
        help
            Forces board_display_init to return ESP_FAIL to test headless keyboard fallback.

    config OPAD_TEST_FAIL_NVS
        bool "Force NVS initialization to fail (P0-1 test)"
        default n
        help
            Forces counters_init to fail NVS initialization to test RAM-only counter fallback.

    config OPAD_BENCH_HID_ONLY
        bool "HID-only benchmark mode (skips UI, CDC task, runtime supervisor)"
        default n
        help
            Stage A latency benchmarking: only USB HID and keypad task run.

    config OPAD_BENCH_NO_DISPLAY
        bool "Stage B benchmark mode (daemon connected, no display updates)"
        default n
        help
            Stage B latency benchmarking: CDC task runs, but display updates are disabled.

    config OPAD_HALL_BENCH
        bool "Hall bench: stream the HE module's raw sensor readings over CDC"
        default n
        help
            V2-0 measurement build (docs/specs/v2-rapid-trigger.md). Streams
            text over the CDC port, so opad-daemon must be stopped. Read it with
            scripts/hall_bench.py.

    config OPAD_HE_BACKEND
        bool "Hall Effect key input (experimental)"
        default n
        depends on !OPAD_HALL_BENCH
        select ADC_CONTINUOUS_ISR_IRAM_SAFE
        help
            With the HE module fitted, read both keys through ADC1 continuous
            DMA and the rapid-trigger engine instead of turning key input off.
            Uncalibrated, provisional thresholds only, not validated on a pad
            yet (docs/specs/v2-hall-effect-decisions.md). MX pads are not
            affected: nothing here runs unless the HE module is detected at
            boot. Selects the IRAM-safe ADC interrupt, so frames keep coming
            while flash is written.

    config OPAD_HE_TRACE
        bool "Hall Effect trace: stream every raw conversion over CDC"
        default n
        depends on OPAD_HE_BACKEND
        help
            Measurement build for the rapid-trigger noise floor (OPEN A in
            docs/specs/v2-hall-effect-decisions.md). Streams ~150 KB/s of
            binary over the CDC port, so opad-daemon must let go of it; record
            with scripts/he_trace.py. Latency measured in this build does not
            count.

    config OPAD_HE_DEBUG
        bool "Hall Effect debug firmware: log every press, readings and ADC health"
        default n
        depends on OPAD_HE_BACKEND && !OPAD_HE_TRACE
        help
            A debug firmware for chasing wrong presses on HE pads. Logs every
            press and release the engine makes with the readings just before
            it, per-second reading ranges, ADC health, pad state, screen
            animation and chip temperature, as LogEvents tagged "he.*" that
            opad-daemon writes to he-debug.log. With the MX module it logs
            "he.mx*" lines instead (input/mx_debug.h): every tap, taps the
            pins saw but the pad never sent, and keys turned off by the
            module check. Works with the daemon and tosu running, during
            maps. Adds latency on purpose; never a release build. The
            firmware version gets a "+hedebug" suffix.

    config OPAD_UI_PERF_TEST
        bool "UI performance test: loop idle -> playing -> SS result with FPS and memory overlays"
        default n
        help
            Evaluation build for the display (not a product build). Plays a
            fake osu! session in a loop on the real screens: idle, a 25 s song
            on the playing screen with tosu-like data at 10 Hz, then the SS
            result animation. LVGL's FPS/CPU and memory monitors stay on top.
            Host status from the daemon is ignored so it cannot end the fake
            map; do not run osu!/tosu meanwhile. Keys and touch keep working.
            Combine with OPAD_LVGL_PSRAM to compare.

    config OPAD_LVGL_PSRAM
        bool "LVGL memory pool in PSRAM"
        default n
        help
            Allocate LVGL's memory pool (CONFIG_LV_MEM_SIZE_KILOBYTES) from
            PSRAM at boot instead of a static array in internal RAM. Frees the
            pool's size in internal RAM; LVGL work that misses the cache gets
            slower. The draw buffers stay in internal DMA RAM either way.

    config OPAD_BENCH_DEBUG_GPIO
        bool "Toggle debug GPIO right after HID submit"
        default n
        help
            Toggles a debug GPIO immediately after HID report submission for logic analyzer correlation.

    config OPAD_BENCH_DEBUG_GPIO_NUM
        int "Debug GPIO number"
        default 4
        depends on OPAD_BENCH_DEBUG_GPIO
        help
            Free GPIO pin on Waveshare header (default 4).

    config OPAD_DEBUG_I2C_SCAN
        bool "Log every device on the touch I2C bus at boot"
        default n
        help
            Probes all 126 I2C addresses before touch retry starts and logs the ones
            that answer. Each missing address can take up to 10 ms, so this adds up
            to ~1.3 s to boot.

endmenu
```
