## firmware/main/Kconfig.projbuild
```kconfig
menu "OPad Testing and Benchmark"

    config OSUPAD_TEST_FAIL_LCD
        bool "Force display initialization to fail (P0-1 test)"
        default n
        help
            Forces board_display_init to return ESP_FAIL to test headless keyboard fallback.

    config OSUPAD_TEST_FAIL_NVS
        bool "Force NVS initialization to fail (P0-1 test)"
        default n
        help
            Forces counters_init to fail NVS initialization to test RAM-only counter fallback.

    config OSUPAD_BENCH_HID_ONLY
        bool "HID-only benchmark mode (skips UI, CDC task, runtime supervisor)"
        default n
        help
            Stage A latency benchmarking: only USB HID and keypad task run.

    config OSUPAD_BENCH_NO_DISPLAY
        bool "Stage B benchmark mode (daemon connected, no display updates)"
        default n
        help
            Stage B latency benchmarking: CDC task runs, but display updates are disabled.

    config OSUPAD_HALL_BENCH
        bool "Hall bench: stream the HE module's raw sensor readings over CDC"
        default n
        help
            V2-0 measurement build (docs/specs/v2-rapid-trigger.md). Streams
            text over the CDC port, so opad-daemon must be stopped. Read it with
            scripts/hall_bench.py.

    config OSUPAD_UI_PERF_TEST
        bool "UI performance test: loop idle -> playing -> SS result with FPS and memory overlays"
        default n
        help
            Evaluation build for the display (not a product build). Plays a
            fake osu! session in a loop on the real screens: idle, a 25 s song
            on the playing screen with tosu-like data at 10 Hz, then the SS
            result animation. LVGL's FPS/CPU and memory monitors stay on top.
            Host status from the daemon is ignored so it cannot end the fake
            map; do not run osu!/tosu meanwhile. Keys and touch keep working.
            Combine with OSUPAD_LVGL_PSRAM and OSUPAD_LCD_PCLK_80MHZ to compare.

    config OSUPAD_LVGL_PSRAM
        bool "LVGL memory pool in PSRAM"
        default n
        help
            Allocate LVGL's memory pool (CONFIG_LV_MEM_SIZE_KILOBYTES) from
            PSRAM at boot instead of a static array in internal RAM. Frees the
            pool's size in internal RAM; LVGL work that misses the cache gets
            slower. The draw buffers stay in internal DMA RAM either way.

    config OSUPAD_LCD_PCLK_80MHZ
        bool "LCD SPI clock 80 MHz instead of 40 MHz"
        default n
        help
            Halves the time to send a frame (full screen ~15 ms instead of
            ~31 ms). Above the ST7789's rated 62.5 MHz write clock: check for
            artifacts. ESP-IDF allows 80 MHz on the S3 through the GPIO matrix.

    config OSUPAD_BENCH_DEBUG_GPIO
        bool "Toggle debug GPIO right after HID submit"
        default n
        help
            Toggles a debug GPIO immediately after HID report submission for logic analyzer correlation.

    config OSUPAD_BENCH_DEBUG_GPIO_NUM
        int "Debug GPIO number"
        default 4
        depends on OSUPAD_BENCH_DEBUG_GPIO
        help
            Free GPIO pin on Waveshare header (default 4).

    config OSUPAD_DEBUG_I2C_SCAN
        bool "Log every device on the touch I2C bus at boot"
        default n
        help
            Probes all 126 I2C addresses before touch retry starts and logs the ones
            that answer. Each missing address can take up to 10 ms, so this adds up
            to ~1.3 s to boot.

endmenu
```
